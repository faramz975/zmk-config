## config/boards/shields/domestos/Kconfig.defconfig
```kconfig
if SHIELD_DOMESTOS_RIGHT

config ZMK_KEYBOARD_NAME
    default "domestos"

config ZMK_SPLIT_ROLE_CENTRAL
    default y

endif

if SHIELD_DOMESTOS_LEFT || SHIELD_DOMESTOS_RIGHT

config ZMK_SPLIT
    default y

endif
```

## config/boards/shields/domestos/Kconfig.shield
```kconfig
config SHIELD_DOMESTOS_LEFT
    def_bool $(shields_list_contains,domestos_left)

config SHIELD_DOMESTOS_RIGHT
    def_bool $(shields_list_contains,domestos_right) 
```
